## main/Kconfig.projbuild
```kconfig
config DEV_MODE
    bool "Dev mode: POST /debug/update (OTA) and GET /debug/version"
    help
        Needs two app slots: build with the dev preset, which adds sdkconfig.dev.
```

## sdkconfig.defaults
```kconfig
CONFIG_TINYUSB_HID_COUNT=1
CONFIG_ESPTOOLPY_FLASHSIZE_8MB=y
CONFIG_ESP_DEFAULT_CPU_FREQ_MHZ_80=y
CONFIG_PM_ENABLE=y
CONFIG_FREERTOS_USE_TICKLESS_IDLE=y
CONFIG_TINYUSB_SUSPEND_CALLBACK=y
CONFIG_TINYUSB_RESUME_CALLBACK=y
CONFIG_TINYUSB_PM=y
```
